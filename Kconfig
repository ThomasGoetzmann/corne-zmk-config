## Kconfig
```kconfig
config ZMK_BEHAVIOR_BAT_RGB
    bool
    default y
    depends on ZMK_RGB_UNDERGLOW && ZMK_BATTERY_REPORTING

config ZMK_BEHAVIOR_MODE_RGB
    bool
    default y
    depends on ZMK_RGB_UNDERGLOW
```

## boards/arm/corne_choc_pro/Kconfig.defconfig
```kconfig
# Copyright (c) 2020 The ZMK Contributors
# SPDX-License-Identifier: MIT

if BOARD_CORNE_CHOC_PRO_LEFT

config ZMK_KEYBOARD_NAME
	default "Corne Choc Pro"

config ZMK_SPLIT_ROLE_CENTRAL
    default y

endif # BOARD_CORNE_CHOC_PRO_LEFT

if BOARD_CORNE_CHOC_PRO_LEFT || BOARD_CORNE_CHOC_PRO_RIGHT 

config BOARD
    default "corne_choc_pro"

config ZMK_SPLIT
    default y

if USB

config USB_NRFX
	default y

config USB_DEVICE_STACK
	default y

endif # USB

config BT_CTLR
	default BT

config I2C
	default y

config ZMK_MAX17048
    default y

config CONFIG_ZMK_SPLIT_BLE_CENTRAL_BATTERY_LEVEL_FETCHING
	bool "Enable fetching split peripheral battery levels to the central side"
	default y

config CONFIG_ZMK_SPLIT_BLE_CENTRAL_BATTERY_LEVEL_PROXY
	bool "Enable central reporting of split battery levels to hosts"
	default y

endif # BOARD_CORNE_CHOC_PRO_LEFT || BOARD_CORNE_CHOC_PRO_RIGHT
```

## boards/arm/sofle_choc_pro/Kconfig
```kconfig
# SPDX-License-Identifier: MIT

config BOARD_ENABLE_DCDC
	bool "Enable DCDC mode"
	select SOC_DCDC_NRF52X
	default y
	depends on (BOARD_SOFLE_CHOC_PRO_LEFT || BOARD_SOFLE_CHOC_PRO_RIGHT)
```

## boards/arm/sofle_choc_pro/Kconfig.board
```kconfig
# Copyright (c) 2020 The ZMK Contributors
# SPDX-License-Identifier: MIT

config BOARD_SOFLE_CHOC_PRO_LEFT
	bool "Sofle Choc Pro Left"
	depends on SOC_NRF52840_QIAA

config BOARD_SOFLE_CHOC_PRO_RIGHT
    bool "Sofle Choc Pro Right"
    depends on SOC_NRF52840_QIAA
```

## boards/keebart/corne_choc_pro/board.yml
```yaml
boards:
  - name: corne_choc_pro_left
    vendor: keebart
    socs:
      - name: nrf52840
        variants:
          - name: zmk
  - name: corne_choc_pro_right
    vendor: keebart
    socs:
      - name: nrf52840
        variants:
          - name: zmk
```

## dts/bindings/behaviors/zmk,behavior-mode-rgb.yaml
```yaml
# Copyright (c) 2024 The ZMK Contributors
# SPDX-License-Identifier: MIT

description: |
  Fixed-color RGB underglow pulse for mode indication.
  Takes a single HSB hue value (0-359); saturation and brightness are always 100.
  The pulse duration is controlled by pulse-ms (default 1000 ms, same as bat_rgb).

compatible: "zmk,behavior-mode-rgb"

properties:
  "#binding-cells":
    type: int
    const: 1
  pulse-ms:
    type: int
    default: 1000
    description: Duration of the RGB pulse in milliseconds
```
